## sdkconfig.defaults
```kconfig
# Estação Meteorológica - Configurações padrão do projeto
# Gerado para ESP-IDF

# I2C
CONFIG_I2C_MASTER_FREQUENCY=400000

# FreeRTOS
CONFIG_FREERTOS_HZ=1000
CONFIG_FREERTOS_USE_TRACE_FACILITY=y

# Logging
CONFIG_LOG_DEFAULT_LEVEL_INFO=y
CONFIG_LOG_MAXIMUM_LEVEL_VERBOSE=y

# Stack sizes
CONFIG_ESP_MAIN_TASK_STACK_SIZE=4096

# Partition Table Configuration
CONFIG_PARTITION_TABLE_CUSTOM=y
CONFIG_PARTITION_TABLE_CUSTOM_FILENAME="partitions.csv"
CONFIG_PARTITION_TABLE_FILENAME="partitions.csv"
```
